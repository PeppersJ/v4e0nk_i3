/**
 * @cliArgs --board "/ti/boards/CC1352R1_LAUNCHXL" --product "simplelink_cc13x2_26x2_sdk@4.20.00.35"
 * @versions {"data":"2020090214","timestamp":"2020090214","tool":"1.6.0+1543","templates":"2020090214"}
 */

/**
 * Import the modules used in this configuration.
 */
const CCFG   = scripting.addModule("/ti/devices/CCFG");
const ADC    = scripting.addModule("/ti/drivers/ADC", {}, false);
const ADC1   = ADC.addInstance();
const GPIO   = scripting.addModule("/ti/drivers/GPIO");
const GPIO1  = GPIO.addInstance();
const PWM    = scripting.addModule("/ti/drivers/PWM", {}, false);
const PWM1   = PWM.addInstance();
const Power  = scripting.addModule("/ti/drivers/Power");
const RTOS   = scripting.addModule("/ti/drivers/RTOS");
const Timer  = scripting.addModule("/ti/drivers/Timer", {}, false);
const Timer1 = Timer.addInstance();
const UART   = scripting.addModule("/ti/drivers/UART", {}, false);
const UART1  = UART.addInstance();

/**
 * Write custom configuration values to the imported modules.
 */
CCFG.ccfgTemplate.$name = "ti_devices_CCFGTemplate0";

ADC1.$name                = "CONFIG_ADC_0";
ADC1.adc.$assign          = "ADC0";
ADC1.adc.adcPin.$assign   = "boosterpack.2";
ADC1.adcPinInstance.$name = "CONFIG_PIN_1";

GPIO1.$name              = "CONFIG_GPIO_LED_0";
GPIO1.initialOutputState = "High";
GPIO1.$hardware          = system.deviceData.board.components.LED_RED;
GPIO1.pinInstance.$name  = "CONFIG_PIN_0";

PWM1.$name                            = "CONFIG_PWM_0";
PWM1.$hardware                        = system.deviceData.board.components.LED_GREEN;
PWM1.timerObject.$name                = "CONFIG_GPTIMER_0";
PWM1.timerObject.pwmPinInstance.$name = "CONFIG_PIN_3";

Timer1.$name               = "CONFIG_TIMER_0";
Timer1.timerInstance.$name = "CONFIG_GPTIMER_1";

UART1.$name               = "CONFIG_UART_0";
UART1.$hardware           = system.deviceData.board.components.XDS110UART;
UART1.dataDirection       = "Send Only";
UART1.txPinInstance.$name = "CONFIG_PIN_2";

/**
 * Pinmux solution for unlocked pins/peripherals. This ensures that minor changes to the automatic solver in a future
 * version of the tool will not impact the pinmux you originally saw.  These lines can be completely deleted in order to
 * re-solve from scratch.
 */
GPIO1.gpioPin.$suggestSolution                 = "boosterpack.39";
PWM1.timerObject.timer.$suggestSolution        = "GPTM1";
PWM1.timerObject.timer.pwmPin.$suggestSolution = "boosterpack.40";
Timer1.timerInstance.timer.$suggestSolution    = "GPTM0";
UART1.uart.$suggestSolution                    = "UART0";
UART1.uart.txPin.$suggestSolution              = "boosterpack.4";
