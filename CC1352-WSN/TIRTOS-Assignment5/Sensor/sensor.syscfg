/**
 * @cliArgs --board "/ti/boards/CC1352R1_LAUNCHXL" --product "simplelink_cc13x2_26x2_sdk@4.20.00.35"
 * @versions {"data":"2020090214","timestamp":"2020090214","tool":"1.6.0+1543","templates":"2020090214"}
 */

/**
 * Import the modules used in this configuration.
 */
const CCFG       = scripting.addModule("/ti/devices/CCFG");
const rfdesign   = scripting.addModule("/ti/devices/radioconfig/rfdesign");
const Display    = scripting.addModule("/ti/display/Display");
const Display1   = Display.addInstance();
const ADC        = scripting.addModule("/ti/drivers/ADC", {}, false);
const ADC1       = ADC.addInstance();
const GPIO       = scripting.addModule("/ti/drivers/GPIO", {}, false);
const GPIO5      = GPIO.addInstance();
const GPIO6      = GPIO.addInstance();
const GPIO7      = GPIO.addInstance();
const I2C        = scripting.addModule("/ti/drivers/I2C", {}, false);
const I2C1       = I2C.addInstance();
const NVS        = scripting.addModule("/ti/drivers/NVS");
const NVS1       = NVS.addInstance();
const RF         = scripting.addModule("/ti/drivers/RF");
const RTOS       = scripting.addModule("/ti/drivers/RTOS");
const SPI        = scripting.addModule("/ti/drivers/SPI", {}, false);
const SPI1       = SPI.addInstance();
const Button     = scripting.addModule("/ti/drivers/apps/Button");
const Button1    = Button.addInstance();
const Button2    = Button.addInstance();
const LED        = scripting.addModule("/ti/drivers/apps/LED");
const LED1       = LED.addInstance();
const LED2       = LED.addInstance();
const ti154stack = scripting.addModule("/ti/ti154stack/ti154stack");

/**
 * Write custom configuration values to the imported modules.
 */
CCFG.enableBootloader         = true;
CCFG.enableBootloaderBackdoor = true;
CCFG.dioBootloaderBackdoor    = 15;
CCFG.levelBootloaderBackdoor  = "Active low";
CCFG.ccfgTemplate.$name       = "ti_devices_CCFGTemplate0";

Display1.$hardware                = system.deviceData.board.components.XDS110UART;
Display1.$name                    = "CONFIG_DISPLAY";
Display1.uart.$name               = "CONFIG_DISPLAY_UART";
Display1.uart.txPinInstance.$name = "CONFIG_PIN_UART_TX";
Display1.uart.rxPinInstance.$name = "CONFIG_PIN_UART_RX";

ADC1.$name                = "CONFIG_ADC_0";
ADC1.adc.adcPin.$assign   = "boosterpack.2";
ADC1.adcPinInstance.$name = "CONFIG_PIN_0";

GPIO5.$name             = "CONFIG_GPIO_OPT_INT";
GPIO5.pull              = "Pull Up";
GPIO5.gpioPin.$assign   = "boosterpack.25";
GPIO5.pinInstance.$name = "CONFIG_PIN_1";

GPIO6.$name             = "CONFIG_GPIO_HDC_INT";
GPIO6.gpioPin.$assign   = "boosterpack.23";
GPIO6.pinInstance.$name = "CONFIG_PIN_2";

GPIO7.$name              = "CONFIG_GPIO_SPI_SS";
GPIO7.$hardware          = system.deviceData.board.components.MX25R8035F.subComponents.SELECT;
GPIO7.initialOutputState = "High";
GPIO7.pinInstance.$name  = "CONFIG_PIN_3";
GPIO7.gpioPin.$assign    = "boosterpack.38";

I2C1.$name                = "CONFIG_I2C_0";
I2C1.i2c.sdaPin.$assign   = "boosterpack.10";
I2C1.i2c.sclPin.$assign   = "boosterpack.9";
I2C1.sdaPinInstance.$name = "CONFIG_PIN_4";
I2C1.clkPinInstance.$name = "CONFIG_PIN_5";

NVS1.$name                    = "CONFIG_NVSINTERNAL";
NVS1.internalFlash.$name      = "ti_drivers_nvs_NVSCC26XX0";
NVS1.internalFlash.regionBase = 0x52000;
NVS1.internalFlash.regionSize = 0x4000;

SPI1.$name                 = "CONFIG_SPI_0";
SPI1.$hardware             = system.deviceData.board.components.LP_SPI;
SPI1.sclkPinInstance.$name = "CONFIG_PIN_6";
SPI1.misoPinInstance.$name = "CONFIG_PIN_7";
SPI1.mosiPinInstance.$name = "CONFIG_PIN_8";

Button1.$hardware                 = system.deviceData.board.components["BTN-1"];
Button1.$name                     = "CONFIG_BTN_LEFT";
Button1.gpioPin.$name             = "CONFIG_GPIO_BTN1";
Button1.gpioPin.pinInstance.$name = "CONFIG_PIN_BTN1";

Button2.$hardware                 = system.deviceData.board.components["BTN-2"];
Button2.$name                     = "CONFIG_BTN_RIGHT";
Button2.gpioPin.$name             = "CONFIG_GPIO_BTN2";
Button2.gpioPin.pinInstance.$name = "CONFIG_PIN_BTN2";

LED1.$hardware                 = system.deviceData.board.components.LED_RED;
LED1.$name                     = "CONFIG_LED_RED";
LED1.gpioPin.$name             = "CONFIG_GPIO_RLED";
LED1.gpioPin.pinInstance.$name = "CONFIG_PIN_RLED";

LED2.$hardware                 = system.deviceData.board.components.LED_GREEN;
LED2.$name                     = "CONFIG_LED_GREEN";
LED2.gpioPin.$name             = "CONFIG_GPIO_GLED";
LED2.gpioPin.pinInstance.$name = "CONFIG_PIN_GLED";

ti154stack.project                            = "sensor";
ti154stack.lockProject                        = true;
ti154stack.radioConfig.$name                  = "ti_devices_radioconfig_settings_prop0";
ti154stack.radioConfig.codeExportConfig.$name = "ti_devices_radioconfig_code_export_param0";
ti154stack.aesccmModule.$name                 = "CONFIG_AESCCM_0";

/**
 * Pinmux solution for unlocked pins/peripherals. This ensures that minor changes to the automatic solver in a future
 * version of the tool will not impact the pinmux you originally saw.  These lines can be completely deleted in order to
 * re-solve from scratch.
 */
Display1.uart.uart.$suggestSolution       = "UART1";
Display1.uart.uart.txPin.$suggestSolution = "boosterpack.4";
Display1.uart.uart.rxPin.$suggestSolution = "boosterpack.3";
ADC1.adc.$suggestSolution                 = "ADC0";
I2C1.i2c.$suggestSolution                 = "I2C0";
SPI1.spi.$suggestSolution                 = "SSI0";
SPI1.spi.sclkPin.$suggestSolution         = "boosterpack.7";
SPI1.spi.misoPin.$suggestSolution         = "boosterpack.14";
SPI1.spi.mosiPin.$suggestSolution         = "boosterpack.15";
SPI1.spi.dmaRxChannel.$suggestSolution    = "DMA_CH3";
SPI1.spi.dmaTxChannel.$suggestSolution    = "DMA_CH4";
Button1.gpioPin.gpioPin.$suggestSolution  = "boosterpack.13";
Button2.gpioPin.gpioPin.$suggestSolution  = "boosterpack.12";
LED1.gpioPin.gpioPin.$suggestSolution     = "boosterpack.39";
LED2.gpioPin.gpioPin.$suggestSolution     = "boosterpack.40";
